## boards/aesir/skoll/Kconfig.skoll
```kconfig
# Copyright (c) 2021 Linaro Limited
# SPDX-License-Identifier: Apache-2.0


config BOARD_SKOLL
	select SOC_STM32F405XX
```

## build/Kconfig/Kconfig.shield.defconfig
```kconfig
osource "/home/faand/fjalar_firmware/application/skoll_acs/boards/shields/*/Kconfig.defconfig"
```
